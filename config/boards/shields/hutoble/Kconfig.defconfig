## config/boards/shields/hutoble/Kconfig.defconfig
```kconfig
# Copyright (c) 2022 The ZMK Contributors
# SPDX-License-Identifier: MIT


CONFIG_ZMK_BLE_CLEAR_BONDS_ON_START=y


if SHIELD_hutoble_LEFT

config ZMK_KEYBOARD_NAME
    default "hutoble"
    
config ZMK_SPLIT_ROLE_CENTRAL
    default y

endif

if SHIELD_hutoble_LEFT || SHIELD_hutoble_RIGHT

CLEAR_ZMK_BLE_CLEAR_BONDS_ON_START=y

config ZMK_SPLIT
    default y

endif
```

## config/boards/shields/hutoble/Kconfig.shield
```kconfig
# Copyright (c) 2022 The ZMK Contributors
# SPDX-License-Identifier: MIT

config SHIELD_hutoble_LEFT
    def_bool $(shields_list_contains,hutoble_left)

config SHIELD_hutoble_RIGHT
    def_bool $(shields_list_contains,hutoble_right)
```

## config/boards/shields/hutoblev1a/Kconfig.defconfig
```kconfig
# Copyright (c) 2022 The ZMK Contributors
# SPDX-License-Identifier: MIT

if SHIELD_hutoblev1a

config ZMK_KEYBOARD_NAME
    default "hutoblev1a"
    
endif
```

## config/boards/shields/hutoblev1a/Kconfig.shield
```kconfig
# Copyright (c) 2022 The ZMK Contributors
# SPDX-License-Identifier: MIT

if SHIELD_hutoblev1a

config SHIELD_hutoblev1a
    def_bool $(shields_list_contains,hutoblev1a)
    
    config ZMK_KEYBOARD_NAME
        default "hutoblev6"
    
endif
```

## config/boards/shields/hutoblev3/Kconfig.defconfig
```kconfig
# Copyright (c) 2022 The ZMK Contributors
# SPDX-License-Identifier: MIT

if SHIELD_hutoblev3_LEFT

config ZMK_KEYBOARD_NAME
    default "hutoblev3"
    
config ZMK_SPLIT_ROLE_CENTRAL
    default y

endif

if SHIELD_hutoblev3_LEFT || SHIELD_hutoblev3_RIGHT

config ZMK_SPLIT
    default y

endif
```

## config/boards/shields/hutoblev3/Kconfig.shield
```kconfig
# Copyright (c) 2022 The ZMK Contributors
# SPDX-License-Identifier: MIT

config SHIELD_hutoblev3_LEFT
    def_bool $(shields_list_contains,hutoblev3_left)

config SHIELD_hutoblev3_RIGHT
    def_bool $(shields_list_contains,hutoblev3_right)
```

## config/boards/shields/hutoblev4/Kconfig.shield
```kconfig
# Copyright (c) 2022 The ZMK Contributors
# SPDX-License-Identifier: MIT

config SHIELD_hutoblev4_LEFT
    def_bool $(shields_list_contains,hutoblev4_left)

config SHIELD_hutoblev4_RIGHT
    def_bool $(shields_list_contains,hutoblev4_right)
```

## config/boards/shields/hutoblev6/Kconfig.shield
```kconfig
# Copyright (c) 2022 The ZMK Contributors
# SPDX-License-Identifier: MIT

config SHIELD_hutoblev6_LEFT
    def_bool $(shields_list_contains,hutoblev6_left)

config SHIELD_hutoblev6_RIGHT
    def_bool $(shields_list_contains,hutoblev6_right)
```
